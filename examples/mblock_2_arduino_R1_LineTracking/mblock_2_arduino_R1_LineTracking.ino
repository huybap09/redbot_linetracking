// generated by mBlock5 for <Vietduino Uno>
// codes make you happy

#include <Arduino.h>
#include "R1_VAR.h"

float eye_Left_Value;
float eye_Right_Value;
float threshold_left;
float distance_Value;
float threshold_Distance;
float last_lost_dir;
float left_dir;
float speedForward;
float speedBackward;
float threshold_right;
float right_dir;

// void DebugKhaoSatCB(){
//   // DO SOMETHING
// }

// void _delay(float seconds) {
//   long endTime = millis() + seconds * 1000;
//   while(millis() <= endTime) {
//       // _loop();
//   }
// }

void setup(){
    // motor_A.begin(6, 9, 8);
    // motor_B.begin(5, 7, 4);
    threshold_left =  0.5;
    threshold_right = 0.5;
    // threshold_Distance = 20;
    left_dir = 0;
    right_dir = 1;
    last_lost_dir = left_dir;
    speedForward = 50;
    speedBackward = 50;
    while(1) {

        // eye_Left_Value = analogRead(A1);
        // eye_Right_Value = analogRead(A2);
        eye_Left_Value = digitalRead(A3);
        eye_Right_Value = digitalRead(A2);
        // DebugKhaoSatCB();
        if((eye_Left_Value > threshold_left)  &&  (eye_Right_Value > threshold_right)){
          // motor_A.forward(speedForward*255/100);
          // motor_B.forward(speedForward*255/100);
          demoMotor.car_fw(speedForward,speedForward);

        }else{
          if((eye_Left_Value > threshold_left)  &&  (eye_Right_Value < threshold_right)){
            last_lost_dir = left_dir;
            // motor_B.forward(speedForward*255/100);
            // motor_A.stop();
            demoMotor.car_fw(speedForward,0);
          }else{
            if((eye_Left_Value < threshold_left)  &&  (eye_Right_Value > threshold_right)){
              last_lost_dir = right_dir;
              // motor_A.forward(speedForward*255/100);
              // motor_B.stop();
              demoMotor.car_fw(0,speedForward);  

            }else{
              if(last_lost_dir == left_dir){
                // motor_A.backward(speedForward*255/100);
                // motor_B.forward(speedBackward*255/100);
                demoMotor.car_rotateL(speedForward);

              }else{
                // motor_A.forward(speedBackward*255/100);
                // motor_B.backward(speedForward*255/100);
                demoMotor.car_rotateR(speedForward);
              }

            }

          }

        }

        // _delay(0);
    }

}

void loop(){
    // _loop();
}

// void _loop(){
//     delay(0);
//     VIETDUINO_UPDATE;
//     motor_A.checkStop();
//     motor_B.checkStop();
// }

// #define _delay     M_DELAY_S